## west.yml
```yaml
manifest:
  version: 1.0

  projects:
    - name: zephyr
      url: https://github.com/zephyrproject-rtos/zephyr
      revision: v4.4.2  #v4.2.0 was the version that is being used in the course, but it needs sdk 0.16. I installed v4.4.2 (zephyrproject), with sdk 1.0.1, so that's what I'm using here
      import:
        name-allowlist:
          - cmsis_6
          - hal_nxp
          - hal_stm32
          - hal_nordic
        path-prefix: deps
```
